VERSION ""

NS_ :

BS_:

BU_: High_Node Low_Node

BO_ 2 New_Message_2: 2 High_Node
 SG_ New_Signal_2 : 0|8@1- (1,0) [0|0] ""  Low_Node

BO_ 1 New_Message_1: 2 High_Node
 SG_ New_Signal_1 : 0|8@1- (1,0) [0|0] ""  Low_Node

BA_DEF_  "BusType" STRING ;
BA_DEF_DEF_  "BusType" "CAN";
