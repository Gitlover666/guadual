VERSION ""

NS_ :

BS_:

BU_: Light Engine Display
VAL_TABLE_ vt_OnOff 1 "On" 0 "Off" ;

BO_ 1026 Rev_message2: 2 Vector__XXX
 SG_ HeadLight : 8|1@1- (1,0) [0|1] "" Vector__XXX
 SG_ FlashLight : 0|1@1- (1,0) [0|1] "" Vector__XXX

BO_ 1025 Rev_message1: 3 Vector__XXX
 SG_ OnOff : 16|1@1- (1,0) [0|0] "" Vector__XXX
 SG_ EngineSpeed : 0|15@1- (1,0) [0|3500] "rpm" Vector__XXX

BO_ 2 LightState: 2 Light
 SG_ HeadLight : 8|1@1- (1,0) [0|1] ""  Display
 SG_ FlashLight : 0|1@1- (1,0) [0|1] ""  Display

BO_ 1 EngineState: 3 Engine
 SG_ OnOff : 16|1@1- (1,0) [0|0] "" Vector__XXX
 SG_ EngineSpeed : 0|15@1- (1,0) [0|3500] "rpm"  Display

BA_DEF_  "BusType" STRING ;
BA_DEF_DEF_  "BusType" "CAN";
