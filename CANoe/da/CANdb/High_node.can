/*@!Encoding:936*/
//这些操作是满足CAN总线的规则的,当有周期重复时，根据定义的优先级来分配
/*
RM算法就是使用报文的周期来定义优先级，是发生前已经定义好的，周期和优先级成反比。若存在周期相等的情况则在初始时给设置一个不同的优先级。
功能：高优先级组在一定时间内满足一定的发送次数时，则在下次进行发送之前进行优先级反转，高->低，0->1，反转以后需要查看是否可以发送，查询是否满足发送条件，满足发送，不满足的话则继续查询，
      直到该周期时间运行结束后，停止查询，此时优先级会从低->高，1->0，变为原来的高优先级继续发送，紧接着上面的循环执行。

      高优先级未进行反转之前可以直接发送，无须判断是否能够直接发出，因为只要发送到总线上后，迟早会执行，无非时间早晚的问题。
      而高优先级反转为低以后必须需要查询是因为，如果不查询是否满足发送条件的话很有可能会产生很严重的阻塞，导致虽然发送了，但是迟迟得不到执行，
      很有可能会产生一种情况，就是当由低重新变为高以后发送的报文会在上次低的报文之前执行，这样就会产生很大的问题，故必须查询。
exp:
    第一次    0
    第二次    0
              0
              1
              0
              ...
*/
includes
{
  #include "Low_node.can"
  //#include "display.can"
}
/*
MAX最大发送次数：一定时间内的最大发送次数，超过该次数，是触发高优先级反转的条件之一。

total周期时间“一定时间”：当per[10]到达该值以后，会触发清零操作，将cout的0-9清零。

cout[20]是发送次数标志位：0-9是用来控制具体每一个报文的循环发送次数，若大于三次后，是执行高优先级反转的条件之一；
                      10-19是用来防止到达total规定的时间以后，0-9会被清零，若N[0]*MAX < total，则利用10-19把上一次0-9的值重新赋给它们。

arr[10]是发送标志位： 0-9是用来控制具体每一个报文未反转时的发送/关闭，为1时不发送，为0时开启发送。
                      注：发送时需要满足一定的ID要求。

N[9]发送周期：0-8定义每一个报文的发送周期，第9位作为优先级触发条件之一，为1触发，0关闭。

per[11]是时间计数标志位：0-10每执行一次都自动加1，每一位分别有不同的阈值，到达指定值以后，会触发清零操作，重新计时。
                          注：这里的阈值是指报文发送的周期N。

b[10]：高优先级反转后满足一定条件加1，若大于1，则会fsend_count加1。

a[11]：满足N[3]*MAX < total条件加1，是高优先级反转以后能够正常发送的仲裁条件之一，到达4后置1，a[10]是计算每次偷渡次数

tsend_count：本次真实的发送数量，小于等于4。
*/
//定义变量
variables
{
  int MAX = 6;
  int total = 6;
  int cout[20];
  int arr[10];
  int N[10]={1, 1, 20000, 20000, 5000, 5000, 5000, 5000, 10000, 10000};
  //int N[10]={2, 2, 10, 10, 15, 15, 15,15, 15,15};//50
  //int N[10]={2, 2, 5, 5, 10, 10, 10,10, 10,10};//60
  //int N[10]={2, 2, 5, 5, 5, 5, 5,5, 10,10};//70
  //int N[10]={1, 1, 5, 5, 15, 15, 15,15, 15,15};//80
  //int N[10]={1, 1, 5, 5, 5, 5, 10,10, 10,10};//90
  int per[11];
  int a[11];
  int c1, c3, c5, i, j;
  int tsend_count = 0;
  float vv;
  int a1;
  long headLight;
  long hazardFlasher;
  //定义高重要程度的报文
  message 0x1 High_message1 = {dlc=8,byte(0)=0x11,byte(1)=0x22};
  //message 0x2 High_message2 = {dlc=8,byte(0)=0x11,byte(1)=0x22};
  message 0x2 High_message2 = {dlc=8};
  message 0x3 High_message3 = {dlc=8,byte(0)=0x1,byte(1)=0x22};
  message 0x4 High_message4 = {dlc=8,byte(0)=0x12};
  message 0x5 High_message5 = {dlc=8};
  message 0x6 High_message6 = {dlc=8,byte(0)=0x12};
  message 0x7 High_message7 = {dlc=8};
  message 0x8 High_message8 = {dlc=8,byte(0)=0x12};
  message 0x9 High_message9 = {dlc=8};
  message 0x10 High_message10 = {dlc=8,byte(0)=0x12};
  
  message 0x401 Rev_message1 = {dlc=8,byte(0)=0x12};
  message 0x402 Rev_message2 = {dlc=8,byte(0)=0x12};
  //定义定时器
  mstimer mscycle;
  
  
  
  
  //这里的qword留一个疑问，是不是可以转换成dword
  //在C语言中使用的是0x243F6A88L，代表long数据，选择在capl用这种，效果一样
  dword ORIG_P[18] = {
        0x243F6A88, 0x85A308D3, 0x13198A2E, 0x03707344,
        0xA4093822, 0x299F31D0, 0x082EFA98, 0xEC4E6C89,
        0x452821E6, 0x38D01377, 0xBE5466CF, 0x34E90C6C,
        0xC0AC29B7, 0xC97C50DD, 0x3F84D5B5, 0xB5470917,
        0x9216D5D9, 0x8979FB1B
  };

  dword ORIG_S[4][256] = {
    {   0xD1310BA6, 0x98DFB5AC, 0x2FFD72DB, 0xD01ADFB7,
        0xB8E1AFED, 0x6A267E96, 0xBA7C9045, 0xF12C7F99,
        0x24A19947, 0xB3916CF7, 0x0801F2E2, 0x858EFC16,
        0x636920D8, 0x71574E69, 0xA458FEA3, 0xF4933D7E,
        0x0D95748F, 0x728EB658, 0x718BCD58, 0x82154AEE,
        0x7B54A41D, 0xC25A59B5, 0x9C30D539, 0x2AF26013,
        0xC5D1B023, 0x286085F0, 0xCA417918, 0xB8DB38EF,
        0x8E79DCB0, 0x603A180E, 0x6C9E0E8B, 0xB01E8A3E,
        0xD71577C1, 0xBD314B27, 0x78AF2FDA, 0x55605C60,
        0xE65525F3, 0xAA55AB94, 0x57489862, 0x63E81440,
        0x55CA396A, 0x2AAB10B6, 0xB4CC5C34, 0x1141E8CE,
        0xA15486AF, 0x7C72E993, 0xB3EE1411, 0x636FBC2A,
        0x2BA9C55D, 0x741831F6, 0xCE5C3E16, 0x9B87931E,
        0xAFD6BA33, 0x6C24CF5C, 0x7A325381, 0x28958677,
        0x3B8F4898, 0x6B4BB9AF, 0xC4BFE81B, 0x66282193,
        0x61D809CC, 0xFB21A991, 0x487CAC60, 0x5DEC8032,
        0xEF845D5D, 0xE98575B1, 0xDC262302, 0xEB651B88,
        0x23893E81, 0xD396ACC5, 0x0F6D6FF3, 0x83F44239,
        0x2E0B4482, 0xA4842004, 0x69C8F04A, 0x9E1F9B5E,
        0x21C66842, 0xF6E96C9A, 0x670C9C61, 0xABD388F0,
        0x6A51A0D2, 0xD8542F68, 0x960FA728, 0xAB5133A3,
        0x6EEF0B6C, 0x137A3BE4, 0xBA3BF050, 0x7EFB2A98,
        0xA1F1651D, 0x39AF0176, 0x66CA593E, 0x82430E88,
        0x8CEE8619, 0x456F9FB4, 0x7D84A5C3, 0x3B8B5EBE,
        0xE06F75D8, 0x85C12073, 0x401A449F, 0x56C16AA6,
        0x4ED3AA62, 0x363F7706, 0x1BFEDF72, 0x429B023D,
        0x37D0D724, 0xD00A1248, 0xDB0FEAD3, 0x49F1C09B,
        0x075372C9, 0x80991B7B, 0x25D479D8, 0xF6E8DEF7,
        0xE3FE501A, 0xB6794C3B, 0x976CE0BD, 0x04C006BA,
        0xC1A94FB6, 0x409F60C4, 0x5E5C9EC2, 0x196A2463,
        0x68FB6FAF, 0x3E6C53B5, 0x1339B2EB, 0x3B52EC6F,
        0x6DFC511F, 0x9B30952C, 0xCC814544, 0xAF5EBD09,
        0xBEE3D004, 0xDE334AFD, 0x660F2807, 0x192E4BB3,
        0xC0CBA857, 0x45C8740F, 0xD20B5F39, 0xB9D3FBDB,
        0x5579C0BD, 0x1A60320A, 0xD6A100C6, 0x402C7279,
        0x679F25FE, 0xFB1FA3CC, 0x8EA5E9F8, 0xDB3222F8,
        0x3C7516DF, 0xFD616B15, 0x2F501EC8, 0xAD0552AB,
        0x323DB5FA, 0xFD238760, 0x53317B48, 0x3E00DF82,
        0x9E5C57BB, 0xCA6F8CA0, 0x1A87562E, 0xDF1769DB,
        0xD542A8F6, 0x287EFFC3, 0xAC6732C6, 0x8C4F5573,
        0x695B27B0, 0xBBCA58C8, 0xE1FFA35D, 0xB8F011A0,
        0x10FA3D98, 0xFD2183B8, 0x4AFCB56C, 0x2DD1D35B,
        0x9A53E479, 0xB6F84565, 0xD28E49BC, 0x4BFB9790,
        0xE1DDF2DA, 0xA4CB7E33, 0x62FB1341, 0xCEE4C6E8,
        0xEF20CADA, 0x36774C01, 0xD07E9EFE, 0x2BF11FB4,
        0x95DBDA4D, 0xAE909198, 0xEAAD8E71, 0x6B93D5A0,
        0xD08ED1D0, 0xAFC725E0, 0x8E3C5B2F, 0x8E7594B7,
        0x8FF6E2FB, 0xF2122B64, 0x8888B812, 0x900DF01C,
        0x4FAD5EA0, 0x688FC31C, 0xD1CFF191, 0xB3A8C1AD,
        0x2F2F2218, 0xBE0E1777, 0xEA752DFE, 0x8B021FA1,
        0xE5A0CC0F, 0xB56F74E8, 0x18ACF3D6, 0xCE89E299,
        0xB4A84FE0, 0xFD13E0B7, 0x7CC43B81, 0xD2ADA8D9,
        0x165FA266, 0x80957705, 0x93CC7314, 0x211A1477,
        0xE6AD2065, 0x77B5FA86, 0xC75442F5, 0xFB9D35CF,
        0xEBCDAF0C, 0x7B3E89A0, 0xD6411BD3, 0xAE1E7E49,
        0x00250E2D, 0x2071B35E, 0x226800BB, 0x57B8E0AF,
        0x2464369B, 0xF009B91E, 0x5563911D, 0x59DFA6AA,
        0x78C14389, 0xD95A537F, 0x207D5BA2, 0x02E5B9C5,
        0x83260376, 0x6295CFA9, 0x11C81968, 0x4E734A41,
        0xB3472DCA, 0x7B14A94A, 0x1B510052, 0x9A532915,
        0xD60F573F, 0xBC9BC6E4, 0x2B60A476, 0x81E67400,
        0x08BA6FB5, 0x571BE91F, 0xF296EC6B, 0x2A0DD915,
        0xB6636521, 0xE7B9F9B6, 0xFF34052E, 0xC5855664,
        0x53B02D5D, 0xA99F8FA1, 0x08BA4799, 0x6E85076A   },
    {   0x4B7A70E9, 0xB5B32944, 0xDB75092E, 0xC4192623,
        0xAD6EA6B0, 0x49A7DF7D, 0x9CEE60B8, 0x8FEDB266,
        0xECAA8C71, 0x699A17FF, 0x5664526C, 0xC2B19EE1,
        0x193602A5, 0x75094C29, 0xA0591340, 0xE4183A3E,
        0x3F54989A, 0x5B429D65, 0x6B8FE4D6, 0x99F73FD6,
        0xA1D29C07, 0xEFE830F5, 0x4D2D38E6, 0xF0255DC1,
        0x4CDD2086, 0x8470EB26, 0x6382E9C6, 0x021ECC5E,
        0x09686B3F, 0x3EBAEFC9, 0x3C971814, 0x6B6A70A1,
        0x687F3584, 0x52A0E286, 0xB79C5305, 0xAA500737,
        0x3E07841C, 0x7FDEAE5C, 0x8E7D44EC, 0x5716F2B8,
        0xB03ADA37, 0xF0500C0D, 0xF01C1F04, 0x0200B3FF,
        0xAE0CF51A, 0x3CB574B2, 0x25837A58, 0xDC0921BD,
        0xD19113F9, 0x7CA92FF6, 0x94324773, 0x22F54701,
        0x3AE5E581, 0x37C2DADC, 0xC8B57634, 0x9AF3DDA7,
        0xA9446146, 0x0FD0030E, 0xECC8C73E, 0xA4751E41,
        0xE238CD99, 0x3BEA0E2F, 0x3280BBA1, 0x183EB331,
        0x4E548B38, 0x4F6DB908, 0x6F420D03, 0xF60A04BF,
        0x2CB81290, 0x24977C79, 0x5679B072, 0xBCAF89AF,
        0xDE9A771F, 0xD9930810, 0xB38BAE12, 0xDCCF3F2E,
        0x5512721F, 0x2E6B7124, 0x501ADDE6, 0x9F84CD87,
        0x7A584718, 0x7408DA17, 0xBC9F9ABC, 0xE94B7D8C,
        0xEC7AEC3A, 0xDB851DFA, 0x63094366, 0xC464C3D2,
        0xEF1C1847, 0x3215D908, 0xDD433B37, 0x24C2BA16,
        0x12A14D43, 0x2A65C451, 0x50940002, 0x133AE4DD,
        0x71DFF89E, 0x10314E55, 0x81AC77D6, 0x5F11199B,
        0x043556F1, 0xD7A3C76B, 0x3C11183B, 0x5924A509,
        0xF28FE6ED, 0x97F1FBFA, 0x9EBABF2C, 0x1E153C6E,
        0x86E34570, 0xEAE96FB1, 0x860E5E0A, 0x5A3E2AB3,
        0x771FE71C, 0x4E3D06FA, 0x2965DCB9, 0x99E71D0F,
        0x803E89D6, 0x5266C825, 0x2E4CC978, 0x9C10B36A,
        0xC6150EBA, 0x94E2EA78, 0xA5FC3C53, 0x1E0A2DF4,
        0xF2F74EA7, 0x361D2B3D, 0x1939260F, 0x19C27960,
        0x5223A708, 0xF71312B6, 0xEBADFE6E, 0xEAC31F66,
        0xE3BC4595, 0xA67BC883, 0xB17F37D1, 0x018CFF28,
        0xC332DDEF, 0xBE6C5AA5, 0x65582185, 0x68AB9802,
        0xEECEA50F, 0xDB2F953B, 0x2AEF7DAD, 0x5B6E2F84,
        0x1521B628, 0x29076170, 0xECDD4775, 0x619F1510,
        0x13CCA830, 0xEB61BD96, 0x0334FE1E, 0xAA0363CF,
        0xB5735C90, 0x4C70A239, 0xD59E9E0B, 0xCBAADE14,
        0xEECC86BC, 0x60622CA7, 0x9CAB5CAB, 0xB2F3846E,
        0x648B1EAF, 0x19BDF0CA, 0xA02369B9, 0x655ABB50,
        0x40685A32, 0x3C2AB4B3, 0x319EE9D5, 0xC021B8F7,
        0x9B540B19, 0x875FA099, 0x95F7997E, 0x623D7DA8,
        0xF837889A, 0x97E32D77, 0x11ED935F, 0x16681281,
        0x0E358829, 0xC7E61FD6, 0x96DEDFA1, 0x7858BA99,
        0x57F584A5, 0x1B227263, 0x9B83C3FF, 0x1AC24696,
        0xCDB30AEB, 0x532E3054, 0x8FD948E4, 0x6DBC3128,
        0x58EBF2EF, 0x34C6FFEA, 0xFE28ED61, 0xEE7C3C73,
        0x5D4A14D9, 0xE864B7E3, 0x42105D14, 0x203E13E0,
        0x45EEE2B6, 0xA3AAABEA, 0xDB6C4F15, 0xFACB4FD0,
        0xC742F442, 0xEF6ABBB5, 0x654F3B1D, 0x41CD2105,
        0xD81E799E, 0x86854DC7, 0xE44B476A, 0x3D816250,
        0xCF62A1F2, 0x5B8D2646, 0xFC8883A0, 0xC1C7B6A3,
        0x7F1524C3, 0x69CB7492, 0x47848A0B, 0x5692B285,
        0x095BBF00, 0xAD19489D, 0x1462B174, 0x23820E00,
        0x58428D2A, 0x0C55F5EA, 0x1DADF43E, 0x233F7061,
        0x3372F092, 0x8D937E41, 0xD65FECF1, 0x6C223BDB,
        0x7CDE3759, 0xCBEE7460, 0x4085F2A7, 0xCE77326E,
        0xA6078084, 0x19F8509E, 0xE8EFD855, 0x61D99735,
        0xA969A7AA, 0xC50C06C2, 0x5A04ABFC, 0x800BCADC,
        0x9E447A2E, 0xC3453484, 0xFDD56705, 0x0E1E9EC9,
        0xDB73DBD3, 0x105588CD, 0x675FDA79, 0xE3674340,
        0xC5C43465, 0x713E38D8, 0x3D28F89E, 0xF16DFF20,
        0x153E21E7, 0x8FB03D4A, 0xE6E39F2B, 0xDB83ADF7   },
    {   0xE93D5A68, 0x948140F7, 0xF64C261C, 0x94692934,
        0x411520F7, 0x7602D4F7, 0xBCF46B2E, 0xD4A20068,
        0xD4082471, 0x3320F46A, 0x43B7D4B7, 0x500061AF,
        0x1E39F62E, 0x97244546, 0x14214F74, 0xBF8B8840,
        0x4D95FC1D, 0x96B591AF, 0x70F4DDD3, 0x66A02F45,
        0xBFBC09EC, 0x03BD9785, 0x7FAC6DD0, 0x31CB8504,
        0x96EB27B3, 0x55FD3941, 0xDA2547E6, 0xABCA0A9A,
        0x28507825, 0x530429F4, 0x0A2C86DA, 0xE9B66DFB,
        0x68DC1462, 0xD7486900, 0x680EC0A4, 0x27A18DEE,
        0x4F3FFEA2, 0xE887AD8C, 0xB58CE006, 0x7AF4D6B6,
        0xAACE1E7C, 0xD3375FEC, 0xCE78A399, 0x406B2A42,
        0x20FE9E35, 0xD9F385B9, 0xEE39D7AB, 0x3B124E8B,
        0x1DC9FAF7, 0x4B6D1856, 0x26A36631, 0xEAE397B2,
        0x3A6EFA74, 0xDD5B4332, 0x6841E7F7, 0xCA7820FB,
        0xFB0AF54E, 0xD8FEB397, 0x454056AC, 0xBA489527,
        0x55533A3A, 0x20838D87, 0xFE6BA9B7, 0xD096954B,
        0x55A867BC, 0xA1159A58, 0xCCA92963, 0x99E1DB33,
        0xA62A4A56, 0x3F3125F9, 0x5EF47E1C, 0x9029317C,
        0xFDF8E802, 0x04272F70, 0x80BB155C, 0x05282CE3,
        0x95C11548, 0xE4C66D22, 0x48C1133F, 0xC70F86DC,
        0x07F9C9EE, 0x41041F0F, 0x404779A4, 0x5D886E17,
        0x325F51EB, 0xD59BC0D1, 0xF2BCC18F, 0x41113564,
        0x257B7834, 0x602A9C60, 0xDFF8E8A3, 0x1F636C1B,
        0x0E12B4C2, 0x02E1329E, 0xAF664FD1, 0xCAD18115,
        0x6B2395E0, 0x333E92E1, 0x3B240B62, 0xEEBEB922,
        0x85B2A20E, 0xE6BA0D99, 0xDE720C8C, 0x2DA2F728,
        0xD0127845, 0x95B794FD, 0x647D0862, 0xE7CCF5F0,
        0x5449A36F, 0x877D48FA, 0xC39DFD27, 0xF33E8D1E,
        0x0A476341, 0x992EFF74, 0x3A6F6EAB, 0xF4F8FD37,
        0xA812DC60, 0xA1EBDDF8, 0x991BE14C, 0xDB6E6B0D,
        0xC67B5510, 0x6D672C37, 0x2765D43B, 0xDCD0E804,
        0xF1290DC7, 0xCC00FFA3, 0xB5390F92, 0x690FED0B,
        0x667B9FFB, 0xCEDB7D9C, 0xA091CF0B, 0xD9155EA3,
        0xBB132F88, 0x515BAD24, 0x7B9479BF, 0x763BD6EB,
        0x37392EB3, 0xCC115979, 0x8026E297, 0xF42E312D,
        0x6842ADA7, 0xC66A2B3B, 0x12754CCC, 0x782EF11C,
        0x6A124237, 0xB79251E7, 0x06A1BBE6, 0x4BFB6350,
        0x1A6B1018, 0x11CAEDFA, 0x3D25BDD8, 0xE2E1C3C9,
        0x44421659, 0x0A121386, 0xD90CEC6E, 0xD5ABEA2A,
        0x64AF674E, 0xDA86A85F, 0xBEBFE988, 0x64E4C3FE,
        0x9DBC8057, 0xF0F7C086, 0x60787BF8, 0x6003604D,
        0xD1FD8346, 0xF6381FB0, 0x7745AE04, 0xD736FCCC,
        0x83426B33, 0xF01EAB71, 0xB0804187, 0x3C005E5F,
        0x77A057BE, 0xBDE8AE24, 0x55464299, 0xBF582E61,
        0x4E58F48F, 0xF2DDFDA2, 0xF474EF38, 0x8789BDC2,
        0x5366F9C3, 0xC8B38E74, 0xB475F255, 0x46FCD9B9,
        0x7AEB2661, 0x8B1DDF84, 0x846A0E79, 0x915F95E2,
        0x466E598E, 0x20B45770, 0x8CD55591, 0xC902DE4C,
        0xB90BACE1, 0xBB8205D0, 0x11A86248, 0x7574A99E,
        0xB77F19B6, 0xE0A9DC09, 0x662D09A1, 0xC4324633,
        0xE85A1F02, 0x09F0BE8C, 0x4A99A025, 0x1D6EFE10,
        0x1AB93D1D, 0x0BA5A4DF, 0xA186F20F, 0x2868F169,
        0xDCB7DA83, 0x573906FE, 0xA1E2CE9B, 0x4FCD7F52,
        0x50115E01, 0xA70683FA, 0xA002B5C4, 0x0DE6D027,
        0x9AF88C27, 0x773F8641, 0xC3604C06, 0x61A806B5,
        0xF0177A28, 0xC0F586E0, 0x006058AA, 0x30DC7D62,
        0x11E69ED7, 0x2338EA63, 0x53C2DD94, 0xC2C21634,
        0xBBCBEE56, 0x90BCB6DE, 0xEBFC7DA1, 0xCE591D76,
        0x6F05E409, 0x4B7C0188, 0x39720A3D, 0x7C927C24,
        0x86E3725F, 0x724D9DB9, 0x1AC15BB4, 0xD39EB8FC,
        0xED545578, 0x08FCA5B5, 0xD83D7CD3, 0x4DAD0FC4,
        0x1E50EF5E, 0xB161E6F8, 0xA28514D9, 0x6C51133C,
        0x6FD5C7E7, 0x56E14EC4, 0x362ABFCE, 0xDDC6C837,
        0xD79A3234, 0x92638212, 0x670EFA8E, 0x406000E0  },
    {   0x3A39CE37, 0xD3FAF5CF, 0xABC27737, 0x5AC52D1B,
        0x5CB0679E, 0x4FA33742, 0xD3822740, 0x99BC9BBE,
        0xD5118E9D, 0xBF0F7315, 0xD62D1C7E, 0xC700C47B,
        0xB78C1B6B, 0x21A19045, 0xB26EB1BE, 0x6A366EB4,
        0x5748AB2F, 0xBC946E79, 0xC6A376D2, 0x6549C2C8,
        0x530FF8EE, 0x468DDE7D, 0xD5730A1D, 0x4CD04DC6,
        0x2939BBDB, 0xA9BA4650, 0xAC9526E8, 0xBE5EE304,
        0xA1FAD5F0, 0x6A2D519A, 0x63EF8CE2, 0x9A86EE22,
        0xC089C2B8, 0x43242EF6, 0xA51E03AA, 0x9CF2D0A4,
        0x83C061BA, 0x9BE96A4D, 0x8FE51550, 0xBA645BD6,
        0x2826A2F9, 0xA73A3AE1, 0x4BA99586, 0xEF5562E9,
        0xC72FEFD3, 0xF752F7DA, 0x3F046F69, 0x77FA0A59,
        0x80E4A915, 0x87B08601, 0x9B09E6AD, 0x3B3EE593,
        0xE990FD5A, 0x9E34D797, 0x2CF0B7D9, 0x022B8B51,
        0x96D5AC3A, 0x017DA67D, 0xD1CF3ED6, 0x7C7D2D28,
        0x1F9F25CF, 0xADF2B89B, 0x5AD6B472, 0x5A88F54C,
        0xE029AC71, 0xE019A5E6, 0x47B0ACFD, 0xED93FA9B,
        0xE8D3C48D, 0x283B57CC, 0xF8D56629, 0x79132E28,
        0x785F0191, 0xED756055, 0xF7960E44, 0xE3D35E8C,
        0x15056DD4, 0x88F46DBA, 0x03A16125, 0x0564F0BD,
        0xC3EB9E15, 0x3C9057A2, 0x97271AEC, 0xA93A072A,
        0x1B3F6D9B, 0x1E6321F5, 0xF59C66FB, 0x26DCF319,
        0x7533D928, 0xB155FDF5, 0x03563482, 0x8ABA3CBB,
        0x28517711, 0xC20AD9F8, 0xABCC5167, 0xCCAD925F,
        0x4DE81751, 0x3830DC8E, 0x379D5862, 0x9320F991,
        0xEA7A90C2, 0xFB3E7BCE, 0x5121CE64, 0x774FBE32,
        0xA8B6E37E, 0xC3293D46, 0x48DE5369, 0x6413E680,
        0xA2AE0810, 0xDD6DB224, 0x69852DFD, 0x09072166,
        0xB39A460A, 0x6445C0DD, 0x586CDECF, 0x1C20C8AE,
        0x5BBEF7DD, 0x1B588D40, 0xCCD2017F, 0x6BB4E3BB,
        0xDDA26A7E, 0x3A59FF45, 0x3E350A44, 0xBCB4CDD5,
        0x72EACEA8, 0xFA6484BB, 0x8D6612AE, 0xBF3C6F47,
        0xD29BE463, 0x542F5D9E, 0xAEC2771B, 0xF64E6370,
        0x740E0D8D, 0xE75B1357, 0xF8721671, 0xAF537D5D,
        0x4040CB08, 0x4EB4E2CC, 0x34D2466A, 0x0115AF84,
        0xE1B00428, 0x95983A1D, 0x06B89FB4, 0xCE6EA048,
        0x6F3F3B82, 0x3520AB82, 0x011A1D4B, 0x277227F8,
        0x611560B1, 0xE7933FDC, 0xBB3A792B, 0x344525BD,
        0xA08839E1, 0x51CE794B, 0x2F32C9B7, 0xA01FBAC9,
        0xE01CC87E, 0xBCC7D1F6, 0xCF0111C3, 0xA1E8AAC7,
        0x1A908749, 0xD44FBD9A, 0xD0DADECB, 0xD50ADA38,
        0x0339C32A, 0xC6913667, 0x8DF9317C, 0xE0B12B4F,
        0xF79E59B7, 0x43F5BB3A, 0xF2D519FF, 0x27D9459C,
        0xBF97222C, 0x15E6FC2A, 0x0F91FC71, 0x9B941525,
        0xFAE59361, 0xCEB69CEB, 0xC2A86459, 0x12BAA8D1,
        0xB6C1075E, 0xE3056A0C, 0x10D25065, 0xCB03A442,
        0xE0EC6E0E, 0x1698DB3B, 0x4C98A0BE, 0x3278E964,
        0x9F1F9532, 0xE0D392DF, 0xD3A0342B, 0x8971F21E,
        0x1B0A7441, 0x4BA3348C, 0xC5BE7120, 0xC37632D8,
        0xDF359F8D, 0x9B992F2E, 0xE60B6F47, 0x0FE3F11D,
        0xE54CDA54, 0x1EDAD891, 0xCE6279CF, 0xCD3E7E6F,
        0x1618B166, 0xFD2C1D05, 0x848FD2C5, 0xF6FB2299,
        0xF523F357, 0xA6327623, 0x93A83531, 0x56CCCD02,
        0xACF08162, 0x5A75EBB5, 0x6E163697, 0x88D273CC,
        0xDE966292, 0x81B949D0, 0x4C50901B, 0x71C65614,
        0xE6C6C7BD, 0x327A140A, 0x45E1D006, 0xC3F27B9A,
        0xC9AA53FD, 0x62A80F00, 0xBB25BFE2, 0x35BDD2F6,
        0x71126905, 0xB2040222, 0xB6CBCF7C, 0xCD769C2B,
        0x53113EC0, 0x1640E3D3, 0x38ABBD60, 0x2547ADF0,
        0xBA38209C, 0xF746CE76, 0x77AFA1C5, 0x20756060,
        0x85CBFE4E, 0x8AE88DD8, 0x7AAAF9B0, 0x4CF9AA7E,
        0x1948C25C, 0x02FB8A8C, 0x01C36AE4, 0xD6EBE1F9,
        0x90D4F869, 0xA65CDEA0, 0x3F09252D, 0xC208E69F,
        0xB74E6132, 0xCE77E25B, 0x578FDFE3, 0x3AC372E6  }
};


  
  
  const int NN = 16;
  struct BLOWFISH_CTX
  {
     dword  P[16 + 2];
     dword  S[4][256];
  };

  struct BLOWFISH_CTX ctx;
  dword  L[10] = {0x1,0x1}, R[10] = {0x2,0x2};
  int k;
  //char key1[7] = {'T','E','S','T','K','E','Y'};
  char key1[8] = "TESTKEY";
  dword  data=0, datal=0, datar=0;
  
} 

//所有程序的start接口
on start
{ 
  time_clear();
  //目前里面只剩下了一个计时功能
  low_task();
  //高优先级组发送，为什么没有低优先级组，因为有了没有用，高的都发不完，故没有
  high_normal_task();
  //清除发送队列
  clear_mark();
  //开启定时器
  setTimer(mscycle,1);
  //将时间后退1ms
  Start_time_back();
  
}
//一开始的时候调用了时间增加的函数，单数实际上定时器还没有启动，故需要在基础上再减回来
Start_time_back()
{
    if(N[0] != 1)
  {
    per[0]--;
  }
  
  if(N[1] != 1)
  {
    per[1]--;
  }
  
  if(N[2] != 1)
  {
    per[2]--;
  }
  
  if(N[3] != 1)
  {
    per[3]--;
  }
  
  if(N[4] != 1)
  {
    per[4]--;
  }
  if(N[5] != 1)
  {
    per[5]--;
  }
  if(N[6] != 1)
  {
    per[6]--;
  }
  if(N[7] != 1)
  {
    per[7]--;
  }
  if(N[8] != 1)
  {
    per[8]--;
  }
  if(N[9] != 1)
  {
    per[9]--;
  }
}
//主程序：到达定时时间执行下面程序
on timer mscycle
{
  
  time_clear();

  low_task();

  high_normal_task();
  
  inversion_output();

  clear_mark();
  
  setTimer(mscycle,1);
  
}

/*
函数功能：1.每当per到达某一阈值周期以后，会设置清零；
          2.判断是否有报文连续total毫秒内持续发送超过max次；
          3.满足N[0]*MAX < total条件后，实现a累加，超过4时，作为提供后续偷渡的发送条件之一
          4.对不发送的ID计数
*/
time_clear()
{
  //计数开始
  per[0]++;
  per[1]++;
  per[2]++;
  per[3]++;
  per[4]++;
  per[5]++;
  per[6]++;
  per[8]++;
  per[7]++;
  per[9]++;
  per[10]++;
  //总体上判断是否有报文连续total毫秒内持续发送超过max次，不管有没有超过，3毫秒内将各个报文的计数标志位清零
  if(per[10] > total)
  {
    per[10] = 1;
    for(c1=0; c1<10; c1++)
    {
      cout[c1] = 0;
    }
  }
  //设置周期1毫秒，清零触发标志位，同时判断是否满足N[0]*MAX < total反转条件，满足的话这里a++，设置大于MAX + 1清1的目的是满足最大次数的条件；
  if(per[0] >= N[0])
  {
    per[0] = 0;
    arr[0] = 0;
    if(N[0] * MAX < total)
    {
      a[0]++;
      if(a[0] > MAX + 1)
      {
        a[0] = 1;
      }
    }
  }
  
  if(per[1] >= N[1])
  {
    per[1] = 0;
    arr[1] = 0;
    if(N[1] * MAX < total)
    {
      a[1]++;
      if(a[1] > MAX + 1)
      {
        a[1] = 1;
      }
    }   
  }
  
  if(per[2] >= N[2])
  {
    per[2] = 0;
    arr[2] = 0;
    if(N[2] * MAX < total)
    {
      a[2]++;
      if(a[2] > MAX + 1)
      {
        a[2] = 1;
      }
    } 
  }
  
  if(per[3] >= N[3])
  {
    per[3] = 0;
    arr[3] = 0;
    if(N[3] * MAX < total)
    {
      a[3]++;
      if(a[3] > MAX + 1)
      {
        a[3] = 1;
      }
    }
  }
  
  if(per[4] >= N[4])
  {
    per[4] = 0;
    arr[4] = 0;
    if(N[4] * MAX < total)
    {
      a[4]++;
      if(a[4] > MAX + 1)
      {
        a[4] = 1;
      }
    }  
  }
  
  if(per[5] >= N[5])
  {
    per[5] = 0;
    arr[5] = 0;
    if(N[5] * MAX < total)
    {
      a[5]++;
      if(a[5] > MAX + 1)
      {
        a[5] = 1;
      }
    } 
  }
  
  if(per[6] >= N[6])
  {
    per[6] = 0;
    arr[6] = 0; 
    if(N[6] * MAX < total)
    {
      a[6]++;
      if(a[6] > MAX + 1)
      {
        a[6] = 1;
      }
    }
  }
  
  if(per[7] >= N[7])
  {
    per[7] = 0;
    arr[7] = 0;
    if(N[7] * MAX < total)
    {
      a[7]++;
      if(a[7] > MAX + 1)
      {
        a[7] = 1;
      }
    }
  }
  
  if(per[8] >= N[8])
  {
    per[8] = 0;
    arr[8] = 0; 
    if(N[8] * MAX < total)
    {
      a[8]++;
      if(a[8] > MAX + 1)
      {
        a[8] = 1;
      }
    } 
  }
  
  if(per[9] >= N[9])
  {
    per[9] = 0;
    arr[9] = 0;  
    if(N[9] * MAX < total)
    {
      a[9]++;
      if(a[9] > MAX + 1)
      {
        a[9] = 1;
      }
    }
  }
  
}

/*
函数功能：1.发送未反转的高优先级组的消息，只有未反转时以及tsend_count < 4时才可以发送，否则发送队列不允许发送
          2.设置cout[0]来记录发送次数,设置cout[10]来恢复当满足一定条件时上一次的cout[0]的值
          3.在规定时间内发送MAX次将其ID进行反转，将最高位的0->1，同时清空计数标志
          4.每个报文发送完成以后将tsend_count加1
*/
high_normal_task()
{
  if(arr[0] == 0 && tsend_count < 4)
  {
    arr[0] = 1;
    //N[0] * MAX < total的目的是为了防止断点
    if(cout[0] == 0 && N[0] * MAX < total )
    {
      cout[0] = cout[10];
    }
    cout[10]++;  
    cout[0]++;
    
    High_message1.id = 0x1;
    //判断是否大于MAX
    if(cout[0] > MAX )
    {
      High_message1.id = High_message1.id | 0x400;
      cout[0] = 0;
      cout[10] = 0;
    }
    if(High_message1.id == 0x1)
    {
      int k = 0;
      L[k] = High_message1.dword(0);
      R[k] = High_message1.dword(4);
      blowfish();
      High_message1.dword(0) = L[k];
      High_message1.dword(4) = R[k];
      output(High_message1); 
      tsend_count++;
    }
  }  
  
  if(arr[1] == 0 && tsend_count < 4)
  {
    arr[1] = 1;
    if(cout[1] == 0 && N[1] * MAX < total )
    {
      cout[1] = cout[11];
    }
    cout[11]++;
    cout[1]++;
    
    High_message2.id = 0x2;
    if(cout[1] > MAX )
    {
      High_message2.id = High_message2.id | 0x400;
      cout[1] = 0;
      cout[11] = 0;
   
    }
    if(High_message2.id == 0x2)
    {
      int k = 1;
      output(High_message2);
      tsend_count++;
    }
  }

  if(arr[2] == 0 && tsend_count < 4)
  {
    arr[2] = 1;
    if(cout[2] == 0 && N[2] * MAX < total )
    {
      cout[2] = cout[12];
    }
    cout[12]++;
    cout[2]++;
    High_message3.id = 0x3;
    if(cout[2] > MAX )
    {
      High_message3.id = High_message3.id | 0x400;
      cout[2] = 0;
      cout[12] = 0;
    }
   if(High_message3.id == 0x3)
    {
      output(High_message3);
      tsend_count++;
    }  
  }
  
  if(arr[3] == 0 && tsend_count < 4)
  {
    arr[3] = 1;
    if(cout[3] == 0 && N[3] * MAX < total )
    {
      cout[3] = cout[13];
    }
    cout[13]++;
    cout[3]++;
    High_message4.id = 0x4;
    if(cout[3] > MAX )
    {
      High_message4.id = High_message4.id | 0x400;
      cout[3] = 0;
      cout[13] = 0;
    }
    if(High_message4.id == 0x4)
    {
      output(High_message4); 
      tsend_count++;
    }
  }
  
  if(arr[4] == 0 && tsend_count < 4)
  {
    arr[4] = 1;
    if(cout[4] == 0 && N[4] * MAX < total )
    {
      cout[4] = cout[14];
    }
    cout[14]++;
    cout[4]++;
    High_message5.id = 0x5;
    if(cout[4] > MAX )
    {
      High_message5.id = High_message5.id | 0x400;
      cout[4] = 0;
      cout[14] = 0;
    }
    if(High_message5.id == 0x5)
    {
      output(High_message5);
      tsend_count++;
    }   
  }
  
  if(arr[5] == 0 && tsend_count < 4)
  {
    arr[5] = 1;
    if(cout[5] == 0 && N[5] * MAX < total )
    {
      cout[5] = cout[15];
    }
    cout[15]++;
    cout[5]++;
    High_message6.id = 0x6;
    if(cout[5] > MAX )
    {
      High_message6.id = High_message6.id | 0x400;
      cout[5] = 0;
      cout[15] = 0;
    }
    if(High_message6.id == 0x6)
    {
      output(High_message6);
      tsend_count++;
    }
  }
  
  if(arr[6] == 0 && tsend_count < 4)
  {
    arr[6] = 1;
    if(cout[6] == 0 && N[6] * MAX < total )
    {
      cout[6] = cout[16];
    }
    cout[16]++;
    cout[6]++;
    High_message7.id = 0x7;
    if(cout[6] > MAX )
    {
      High_message7.id = High_message7.id | 0x400;
      cout[6] = 0;
      cout[16] = 0;
    }
    if(High_message7.id == 0x7)
    {
      output(High_message7);
      tsend_count++;
    }
  }
  
  if(arr[7] == 0 && tsend_count < 4)
  {
    arr[7] = 1;
    if(cout[7] == 0 && N[7] * MAX < total )
    {
      cout[7] = cout[17];
    }
    cout[17]++;
    cout[7]++;
    
    High_message8.id = 0x8;
    if(cout[7] > MAX )
    {
      High_message8.id = High_message8.id | 0x400;
      cout[7] = 0;
      cout[17] = 0;
    }
    if(High_message8.id == 0x8)
    {
      output(High_message8);
      tsend_count++;
    }
  }
  
  if(arr[8] == 0 && tsend_count < 4)
  {
    arr[8] = 1; 
    if(cout[8] == 0 && N[8] * MAX < total )
    {
      cout[8] = cout[18];
    }
    cout[18]++;
    cout[8]++;
    High_message9.id = 0x9;
    if(cout[8] > MAX )
    {
      High_message9.id = High_message9.id | 0x400;
      cout[8] = 0;
      cout[18] = 0;
    }
    if(High_message9.id == 0x9)
    {
      output(High_message9);
      tsend_count++;
    }
  }

  if(arr[9] == 0 && tsend_count < 4)
  {
    arr[9] = 1;
    if(cout[9] == 0 && N[9] * MAX < total )
    {
      cout[9] = cout[19];
    }
    cout[19]++;
    cout[9]++;
    High_message10.id = 0x10;
    if(cout[9] > MAX )
    {
      High_message10.id = High_message10.id | 0x400;
      cout[9] = 0;
      cout[19] = 0;
    }
    if(High_message10.id == 0x10)
    {
      output(High_message10);
      tsend_count++;
    }
  }
}
/*
函数功能：1.满足条件后实现由高到低以后的发送，只发送低优先级的情况，同时如果发送成功将发送条件破坏，使其只能在下一次周期循环再发
          2.如果不能发的话，若是处于低的期间则会将上次fsend_count累加的数值减1
*/
inversion_output()
{
  if(arr1[10] == 0 && tsend_count < 4)
  {
   output(Low_message1);
   tsend_count++;
   arr1[10] = 1;
  }
  
  if(arr1[11] == 0 && tsend_count < 4)
  {
    output(Low_message2);
    tsend_count++;
    arr1[11] = 1;
  }
  
  if(arr1[12] == 0 && tsend_count < 4)
  {
    output(Low_message3);
    tsend_count++;
    arr1[12] = 1;
  }
  
  if(arr1[13] == 0 && tsend_count < 4)
  {
    output(Low_message4);
    tsend_count++;
    arr1[13] = 1;
  }
  if(arr1[14] == 0 && tsend_count < 4)
  {
    output(Low_message5);
    tsend_count++;
    arr1[14] = 1;
  }
  
  //周期为20ms
  if(arr1[15] == 0 && tsend_count < 4)
  {
    arr1[15] = 1;
    tsend_count++;
    output(Low_message6);
  }
  
  if(arr1[16] == 0 && tsend_count < 4)
  {
    output(Low_message7);
    tsend_count++;
    arr1[16] = 1;
  }
  
  if(arr1[17] == 0 && tsend_count < 4)
  {
    output(Low_message8);
    tsend_count++;
    arr1[17] = 1;
  }
  if(arr1[18] == 0 && tsend_count < 4)
  {
    output(Low_message9);
    tsend_count++;
    arr1[18]=1;
  }
  
  if(arr1[19] == 0 && tsend_count < 4)
  {
    output(Low_message10);
    tsend_count++;
      
    arr1[19] = 1;
    jj = 1;
    MAX = 5;
  }
  //这里可以套出来很多公式，进行复杂化
  if(jj == 0 && per1[2] > 0 && tsend_count <= 4)
  {
    if((float)tsend_count/4 == 1.0)
    {
      write("per1 = %f", (float)per1[2]);
      vv = (float)per1[2];
    }
    else
    {
      write("per2 = %f", (float)per1[2] - (float)tsend_count/4);
      vv = (float)per1[2] - (float)tsend_count/4;
    }
    vv = vv/(float)N1[8];
    /*
    switch(vv*10)
    {
      case 2: MAX = 4; write("max = %d", MAX);break;
      case 4: MAX = 3; write("max = %d", MAX);break;
      case 6: MAX = 2; write("max = %d", MAX);break;
      case 8: MAX = 1; write("max = %d", MAX);break;
    }
         */
  }
  
  if(a[0] == MAX+1 && tsend_count < 4 && High_message1.id != 0x1)
  {
    //High_message1.byte(0) = 0;
    //High_message1.byte(1) = 0;
    output(High_message1);
    //High_message1.byte(0) = 0x11;
    //High_message1.byte(1) = 0x22;
    tsend_count++;
    a[0]++;
  }
  
  if(a[1] == MAX+1 && tsend_count < 4 && High_message2.id != 0x2)
  {
    //High_message2.byte(0) = 0;
    //High_message2.byte(1) = 0;
    output(High_message2); 
    //High_message2.byte(0) = 0x11;
    //High_message2.byte(1) = 0x22;
    tsend_count++;
    a[1]++;
  }
  
  if(a[2] == MAX+1 && tsend_count < 4 && High_message3.id != 0x3)
  {
    High_message3.byte(0) = 0;
    High_message3.byte(1) = 0;
    output(High_message3); 
    High_message3.byte(0) = 0x1;
    High_message3.byte(1) = 0x22;
    tsend_count++;
    a[2]++;
  }
  
  if(a[3] == MAX+1 && tsend_count < 4 && High_message4.id != 0x4)
  {
    output(High_message4); 
    tsend_count++;
    a[3]++;
  }
  
  if(a[4] == MAX+1 && tsend_count < 4 && High_message5.id != 0x5)
  {
    output(High_message5); 
    tsend_count++;
    a[4]++;
  }
  
  if(a[5] == MAX+1 && tsend_count < 4 && High_message6.id != 0x6)
  {
    output(High_message6); 
    tsend_count++;
    a[5]++;
  }
  
  if(a[6] == MAX+1 && tsend_count < 4 && High_message7.id != 0x7)
  {
    output(High_message7); 
    tsend_count++;
    a[6]++;
  }
  
  if(a[7] == MAX+1 && tsend_count < 4 && High_message8.id != 0x8)
  {
    High_message8.byte(0) = 0x11;
    High_message8.byte(1) = 0x22;
    output(High_message8); 
    High_message8.byte(0) = 0x12;
    High_message8.byte(1) = 0;
    tsend_count++;
    a[7]++;
  }
  
  if(a[8] == MAX+1 && tsend_count < 4 && High_message9.id != 0x9)
  {
    High_message9.byte(0) = 0x11;
    output(High_message9); 
    High_message9.byte(0) = 0;
    tsend_count++;
    a[8]++;
  }
  
  if(a[9] == MAX+1 && tsend_count < 4 && High_message2.id != 0x10)
  {
    High_message10.byte(0) = 0x11;
    output(High_message10); 
    High_message10.byte(0) = 0x12;
    High_message10.byte(1) = 0;
    tsend_count++;
    a[9]++;
  }
}

/*
函数功能：将tsend_count发送的数量清零
*/
clear_mark()
{
  tsend_count = 0;
}























/*

Blowfish_Init(7);
  Blowfish_Encrypt();
  //这里字节的影响
  write("%08lx %08lx\n", L, R);

  if (L == 0xDF333FD2 && R == 0x30A71BB4)
	  write("Test encryption OK.\n");
  else
	  write("Test encryption failed.\n");
  Blowfish_Decrypt();
  write("%08x %08x\n", L, R);
  if (L == 1 && R == 2)
  	write("Test decryption OK.\n");
  else
	  write("Test decryption failed.\n");



*/


 dword F(dword x)
  {
   word a, b, c, d = 0;
   dword  y;
   d = (word)(x & 0xFF);
    //write("%d", d);
   x >>= 8;
   c = (word)(x & 0xFF);
   x >>= 8;
   b = (word)(x & 0xFF);
   x >>= 8;
   a = (word)(x & 0xFF);
   y = ctx.S[0][a] + ctx.S[1][b];
   y = y ^ ctx.S[2][c];
   y = y + ctx.S[3][d];
   return y;
}




void Blowfish_Encrypt()
  {
    dword  Xl1, Xr1, temp1;
    word i;
    Xl1 = 0; Xr1 = 0; temp1 = 0;
    
    Xl1 = L[k];
    Xr1 = R[k];
    
    for (i = 0; i < NN; ++i) 
    {
      Xl1 = Xl1 ^ ctx.P[i];//平方
      Xr1 = F(Xl1) ^ Xr1;
      temp1 = Xl1;
      Xl1 = Xr1;
      Xr1 = temp1;
    }
    temp1 = Xl1;
    Xl1 = Xr1;
    Xr1 = temp1;
    Xr1 = Xr1 ^ ctx.P[NN];
    Xl1 = Xl1 ^ ctx.P[NN + 1];
    L[k] = Xl1;//多个报文考虑这样L=L1=....=LN=XL1
    R[k] = Xr1;
}

//1
void Blowfish_Encrypt1()
  {
    dword  Xl, Xr, temp;
    
    word i;
    Xl = 0; Xr = 0; temp = 0;
    
    Xl = datal;
    //write("%d", datal);
    Xr = datar;
    for (i = 0; i < NN; ++i) 
    {
      Xl = Xl ^ ctx.P[i];
      
      Xr = F(Xl) ^ Xr;
      temp = Xl;
      Xl = Xr;
      Xr = temp;
    }
    
    temp = Xl;
    Xl = Xr;
    Xr = temp;
    Xr = Xr ^ ctx.P[NN];
    Xl = Xl ^ ctx.P[NN + 1];
    datal = Xl;
    datar = Xr;
    Xl = 0; Xr = 0; temp = 0;
  }

//这里局部函数在这里定义的变量都是静态变量

void Blowfish_Decrypt()
  {
    dword  Xl3, Xr3, temp3;
    word i;
    Xl3 = 0; Xr3 = 0; temp3 = 0;
    Xl3 = L[k];
    Xr3 = R[k];
    
    for (i = NN + 1; i > 1; --i) 
    {
      Xl3 = Xl3 ^ ctx.P[i];
      Xr3 = F(Xl3) ^ Xr3;
      /* Exchange Xl and Xr */
      temp3 = Xl3;
      Xl3 = Xr3;
      Xr3 = temp3;
    }

    /* Exchange Xl and Xr */
    temp3 = Xl3;
    Xl3 = Xr3;
    Xr3 = temp3;
    Xr3 = Xr3 ^ ctx.P[1];
    Xl3 = Xl3 ^ ctx.P[0];
    L[k] = Xl3;
    R[k] = Xr3;
}




//1
void Blowfish_Init(int	 keyLen) 
  {
    int	 i, j, k;
    for (i = 0; i < 4; i++) {
      for (j = 0; j < 256; j++){
        ctx.S[i][j] = ORIG_S[i][j];
      }
    }
    
    j = 0;
    for (i = 0; i < NN + 2; ++i) 
    {
      data = 0x00000000;
      for (k = 0; k < 4; ++k) 
      {
        data = (data << 8) | key1[j];
        j = j + 1;
        if (j >= keyLen)
          j = 0;
      }
    ctx.P[i] = ORIG_P[i] ^ data;
    }
    
  datal = 0x00000000;
  datar = 0x00000000;
  for (i = 0; i < NN + 2; i += 2) 
  {
    Blowfish_Encrypt1();
    ctx.P[i] = datal;
    ctx.P[i + 1] = datar;
  }
  //write("%x", ctx.P[17]);
  for (i = 0; i < 4; ++i) {
    for (j = 0; j < 256; j += 2)
    {
      Blowfish_Encrypt1();
      ctx.S[i][j] = datal;
      ctx.S[i][j + 1] = datar;
    }
  }
  
}







void blowfish()
  {
    int i;
    for(i=0; i<100; i++)
    {
      if(key1[i] == 0)
      {
        write("   %d", i);
        break;
      }
    }
    Blowfish_Init(i);
    Blowfish_Encrypt();
    
    //这里字节的影响
   /* write("%08lx %08lx", L[k], R[k]);
    if (L[k] == 0xDF333FD2 && R[k] == 0x30A71BB4)
      write("Test encryption OK.");
    else
      write("Test encryption failed.");
    Blowfish_Decrypt();
    write("%08x %08x", L[k], R[k]);
    if (L[k] == 1 && R[k] == 2)
    	write("Test decryption OK.");
    else
      write("Test decryption failed.");*/
}



























on message 0x1, 0x401
{
  /*L = High_message1.dword(0);
  R = High_message1.dword(4);
  blowfish();
  High_message1.dword(0) = L;
  High_message1.dword(4) = R;*/
  //High_message1.dword(0) = 1;
  if(High_message1.dword(0) == L[k] && High_message1.dword(4) == R[k])
  {
    if(@sysvar::Engine::EngineStateSwitch) 
    {   
    
      Blowfish_Decrypt();
      High_message1.word(0) = @Engine::EngineSpeedEntry;
      High_message1.byte(2) = 1;
      
      Rev_message1.word(0) = @Engine::EngineSpeedEntry;
      Rev_message1.byte(2) = 1;
      @Engine::kkk = 1;//启动汽车图标
      }
   
  
  else
  {
    High_message1.word(0) = 0;
    High_message1.byte(2) = 0;
    Rev_message1.word(0) = 0;
    Rev_message1.byte(2) = 0;
    @Engine::kkk = 0;
  }
  @Engine::EngineSpeedDspMeter = High_message1.word(0) / 1000.0;
  @Engine::jjj = High_message1.word(0);//速度值/表盘下方
  }
}



on timer tFlashLightFrequency
{
  gHazardLightsStatus = (gHazardLightsStatus == 1 ? 0 : 1);
  @Lights::fl = gHazardLightsStatus;
  
  High_message2.byte(0) = @Lights::fl;
  
  Rev_message2.byte(0) = @Lights::fl;
  setTimer(tFlashLightFrequency, gFlashLightFrequency);
}




on sysvar sysvar::Lights::HeadLight1
{
  High_message2.byte(1) = @Lights::HeadLight1;
  Rev_message2.byte(1) = @Lights::HeadLight1;
}










