/*@!Encoding:936*/
//这些操作是满足CAN总线的规则的,当有周期重复时，根据定义的优先级来分配
/*
RM算法就是使用报文的周期来定义优先级，是发生前已经定义好的，周期和优先级成反比。若存在周期相等的情况则在初始时给设置一个不同的优先级。
功能：高优先级组在一定时间内满足一定的发送次数时，则在下次进行发送之前进行优先级反转，高->低，0->1，反转以后需要查看是否可以发送，查询是否满足发送条件，满足发送，不满足的话则继续查询，
      直到该周期时间运行结束后，停止查询，此时优先级会从低->高，1->0，变为原来的高优先级继续发送，紧接着上面的循环执行。

      高优先级未进行反转之前可以直接发送，无须判断是否能够直接发出，因为只要发送到总线上后，迟早会执行，无非时间早晚的问题。
      而高优先级反转为低以后必须需要查询是因为，如果不查询是否满足发送条件的话很有可能会产生很严重的阻塞，导致虽然发送了，但是迟迟得不到执行，
      很有可能会产生一种情况，就是当由低重新变为高以后发送的报文会在上次低的报文之前执行，这样就会产生很大的问题，故必须查询。
exp:
    第一次    0
    第二次    0
              0
              1
              0
              ...
*/
includes
{
  #include "Low_node.can"
  #include "display.can"
}
/*
MAX最大发送次数：一定时间内的最大发送次数，超过该次数，是触发高优先级反转的条件之一。

total周期时间“一定时间”：当per[10]到达该值以后，会触发清零操作，将cout的0-9清零。

cout[20]是发送次数标志位：0-9是用来控制具体每一个报文的循环发送次数，若大于三次后，是执行高优先级反转的条件之一；
                      10-19是用来防止到达total规定的时间以后，0-9会被清零，若N[0]*MAX < total，则利用10-19把上一次0-9的值重新赋给它们。

arr[10]是发送标志位： 0-9是用来控制具体每一个报文未反转时的发送/关闭，为1时不发送，为0时开启发送。
                      注：发送时需要满足一定的ID要求。

N[9]发送周期：0-8定义每一个报文的发送周期，第9位作为优先级触发条件之一，为1触发，0关闭。

per[11]是时间计数标志位：0-10每执行一次都自动加1，每一位分别有不同的阈值，到达指定值以后，会触发清零操作，重新计时。
                          注：这里的阈值是指报文发送的周期N。

b[10]：高优先级反转后满足一定条件加1，若大于1，则会fsend_count加1。

a[11]：满足N[3]*MAX < total条件加1，是高优先级反转以后能够正常发送的仲裁条件之一，到达4后置1，a[10]是计算每次偷渡次数

tsend_count：本次真实的发送数量，小于等于4。
*/

//定义变量
variables
{
    //定义定时器
  mstimer mscycle;
  const int gFlashLightFrequency = 500;
  int gHazardLightsStatus = 0;
  
} 

//所有程序的start接口
on start
{ 
  time_clear();
  //目前里面只剩下了一个计时功能
  low_task();
  //高优先级组发送，为什么没有低优先级组，因为有了没有用，高的都发不完，故没有
  high_normal_task();
  //清除发送队列
  clear_mark();
  //开启定时器
  setTimer(mscycle,1);
  //将时间后退1ms
  Start_time_back();
}

//一开始的时候调用了时间增加的函数，单数实际上定时器还没有启动，故需要在基础上再减回来
Start_time_back()
{
  if(N[0] != 1)
  {
    per[0]--;
  }
  
  if(N[1] != 1)
  {
    per[1]--;
  }
  
  if(N[2] != 1)
  {
    per[2]--;
  }
  
  if(N[3] != 1)
  {
    per[3]--;
  }
  
  if(N[4] != 1)
  {
    per[4]--;
  }
  if(N[5] != 1)
  {
    per[5]--;
  }
  if(N[6] != 1)
  {
    per[6]--;
  }
  if(N[7] != 1)
  {
    per[7]--;
  }
  if(N[8] != 1)
  {
    per[8]--;
  }
  if(N[9] != 1)
  {
    per[9]--;
  }
}

//主程序：到达定时时间执行下面程序
on timer mscycle
{
  //kkkl();
  time_clear();

  low_task();

  high_normal_task();
  
  inversion_output();

  clear_mark();
  
  setTimer(mscycle,1);
}

/*
函数功能：1.每当per到达某一阈值周期以后，会设置清零；
          2.判断是否有报文连续total毫秒内持续发送超过max次；
          3.满足N[0]*MAX < total条件后，实现a累加，超过4时，作为提供后续偷渡的发送条件之一
          4.对不发送的ID计数
*/
time_clear()
{
  //计数开始
  per[0]++;
  per[1]++;
  per[2]++;
  per[3]++;
  per[4]++;
  per[5]++;
  per[6]++;
  per[8]++;
  per[7]++;
  per[9]++;
  per[10]++;
  //总体上判断是否有报文连续total毫秒内持续发送超过max次，不管有没有超过，3毫秒内将各个报文的计数标志位清零
  if(per[10] > total)
  {
    per[10] = 1;
    for(c1=0; c1<10; c1++)
    {
      cout[c1] = 0;
    }
  }
  //设置周期1毫秒，清零触发标志位，同时判断是否满足N[0]*MAX < total反转条件，满足的话这里a++，设置大于MAX + 1清1的目的是满足最大次数的条件；
  if(per[0] >= N[0])
  {
    per[0] = 0;
    arr[0] = 0;
    if(N[0] * MAX < total)
    {
      a[0]++;
      if(a[0] > MAX + 1)
      {
        a[0] = 1;
      }
    }
  }
  
  if(per[1] >= N[1])
  {
    per[1] = 0;
    arr[1] = 0;
    if(N[1] * MAX < total)
    {
      a[1]++;
      if(a[1] > MAX + 1)
      {
        a[1] = 1;
      }
    }   
  }
  
  if(per[2] >= N[2])
  {
    per[2] = 0;
    arr[2] = 0;
    if(N[2] * MAX < total)
    {
      a[2]++;
      if(a[2] > MAX + 1)
      {
        a[2] = 1;
      }
    } 
  }
  
  if(per[3] >= N[3])
  {
    per[3] = 0;
    arr[3] = 0;
    if(N[3] * MAX < total)
    {
      a[3]++;
      if(a[3] > MAX + 1)
      {
        a[3] = 1;
      }
    }
  }
  
  if(per[4] >= N[4])
  {
    per[4] = 0;
    arr[4] = 0;
    if(N[4] * MAX < total)
    {
      a[4]++;
      if(a[4] > MAX + 1)
      {
        a[4] = 1;
      }
    }  
  }
  
  if(per[5] >= N[5])
  {
    per[5] = 0;
    arr[5] = 0;
    if(N[5] * MAX < total)
    {
      a[5]++;
      if(a[5] > MAX + 1)
      {
        a[5] = 1;
      }
    } 
  }
  
  if(per[6] >= N[6])
  {
    per[6] = 0;
    arr[6] = 0; 
    if(N[6] * MAX < total)
    {
      a[6]++;
      if(a[6] > MAX + 1)
      {
        a[6] = 1;
      }
    }
  }
  
  if(per[7] >= N[7])
  {
    per[7] = 0;
    arr[7] = 0;
    if(N[7] * MAX < total)
    {
      a[7]++;
      if(a[7] > MAX + 1)
      {
        a[7] = 1;
      }
    }
  }
  
  if(per[8] >= N[8])
  {
    per[8] = 0;
    arr[8] = 0; 
    if(N[8] * MAX < total)
    {
      a[8]++;
      if(a[8] > MAX + 1)
      {
        a[8] = 1;
      }
    } 
  }
  
  if(per[9] >= N[9])
  {
    per[9] = 0;
    arr[9] = 0;  
    if(N[9] * MAX < total)
    {
      a[9]++;
      if(a[9] > MAX + 1)
      {
        a[9] = 1;
      }
    }
  }
  
}

/*
函数功能：1.发送未反转的高优先级组的消息，只有未反转时以及tsend_count < 4时才可以发送，否则发送队列不允许发送
          2.设置cout[0]来记录发送次数,设置cout[10]来恢复当满足一定条件时上一次的cout[0]的值
          3.在规定时间内发送MAX次将其ID进行反转，将最高位的0->1，同时清空计数标志
          4.每个报文发送完成以后将tsend_count加1
*/
high_normal_task()
{  
  if(arr[0] == 0 && tsend_count < 4)
  {
    arr[0] = 1;
    //N[0] * MAX < total的目的是为了防止断点
    if(cout[0] == 0 && N[0] * MAX < total )
    {
      cout[0] = cout[10];
    }
    cout[10]++;  
    cout[0]++;
    
    High_message1.id = 0x1;
    //判断是否大于MAX
    if(cout[0] > MAX )
    {
      High_message1.id = High_message1.id | 0x400;
      cout[0] = 0;
      cout[10] = 0;
    }
    
    //幅值操作
    
    if(High_message1.id == 0x1)
    {    
      k = 0;
      
      Data_cp1();
      //开始加密
      L[0] = High_message1.dword(0);
      R[0] = High_message1.dword(4);
      blowfish(); 
      //将加密的数据赋给报文；
      High_message1.dword(0) = L[0];
      High_message1.dword(4) = R[0];
      
      //High_message1.qword(0) |= High_message1.qword(0);
      //防止偷窥，就算拿到报文，发送了也没有作用
      High_message1.qword(0) = ~High_message1.qword(0);
      
      output(High_message1);
      High_message1.dword(0) = L[0];
      High_message1.dword(4) = R[0];
      cj[0] = 1;
      tsend_count++;
    }
  }  
   
  if(arr[1] == 0 && tsend_count < 4)
  {
    arr[1] = 1;
    if(cout[1] == 0 && N[1] * MAX < total )
    {
      cout[1] = cout[11];
    }
    cout[11]++;
    cout[1]++;
   
    High_message2.id = 0x2;
    if(cout[1] > MAX )
    {
      High_message2.id = High_message2.id | 0x400;
      cout[1] = 0;
      cout[11] = 0;
   
    }
    
    
    if(High_message2.id == 0x2)
    {
      k = 1;
      Data_cp2();      
      L[k] = High_message2.dword(0);
      R[k] = High_message2.dword(4);
      //write("000000000002    %08lx %08lx", L[k], R[k]);
      blowfish();
      //write("000000000002    %08lx %08lx", L[k], R[k]);
      High_message2.dword(0) = L[k];
      High_message2.dword(4) = R[k];
      
      output(High_message2);
      cj[1] = 1;
      tsend_count++;
    }
  }

  if(arr[2] == 0 && tsend_count < 4)
  {
    arr[2] = 1;
    if(cout[2] == 0 && N[2] * MAX < total )
    {
      cout[2] = cout[12];
    }
    cout[12]++;
    cout[2]++;
    High_message3.id = 0x3;
    if(cout[2] > MAX )
    {
      High_message3.id = High_message3.id | 0x400;
      cout[2] = 0;
      cout[12] = 0;
    }
   if(High_message3.id == 0x3)
    {
      output(High_message3);
      tsend_count++;
    }  
  }
  
  if(arr[3] == 0 && tsend_count < 4)
  {
    arr[3] = 1;
    if(cout[3] == 0 && N[3] * MAX < total )
    {
      cout[3] = cout[13];
    }
    cout[13]++;
    cout[3]++;
    High_message4.id = 0x4;
    if(cout[3] > MAX )
    {
      High_message4.id = High_message4.id | 0x400;
      cout[3] = 0;
      cout[13] = 0;
    }
    if(High_message4.id == 0x4)
    {
      output(High_message4); 
      tsend_count++;
    }
  }
  
  if(arr[4] == 0 && tsend_count < 4)
  {
    arr[4] = 1;
    if(cout[4] == 0 && N[4] * MAX < total )
    {
      cout[4] = cout[14];
    }
    cout[14]++;
    cout[4]++;
    High_message5.id = 0x5;
    if(cout[4] > MAX )
    {
      High_message5.id = High_message5.id | 0x400;
      cout[4] = 0;
      cout[14] = 0;
    }
    if(High_message5.id == 0x5)
    {
      output(High_message5);
      tsend_count++;
    }   
  }
  
  if(arr[5] == 0 && tsend_count < 4)
  {
    arr[5] = 1;
    if(cout[5] == 0 && N[5] * MAX < total )
    {
      cout[5] = cout[15];
    }
    cout[15]++;
    cout[5]++;
    High_message6.id = 0x6;
    if(cout[5] > MAX )
    {
      High_message6.id = High_message6.id | 0x400;
      cout[5] = 0;
      cout[15] = 0;
    }
    if(High_message6.id == 0x6)
    {
      output(High_message6);
      tsend_count++;
    }
  }
  
  if(arr[6] == 0 && tsend_count < 4)
  {
    arr[6] = 1;
    if(cout[6] == 0 && N[6] * MAX < total )
    {
      cout[6] = cout[16];
    }
    cout[16]++;
    cout[6]++;
    High_message7.id = 0x7;
    if(cout[6] > MAX )
    {
      High_message7.id = High_message7.id | 0x400;
      cout[6] = 0;
      cout[16] = 0;
    }
    if(High_message7.id == 0x7)
    {
      output(High_message7);
      tsend_count++;
    }
  }
  
  if(arr[7] == 0 && tsend_count < 4)
  {
    arr[7] = 1;
    if(cout[7] == 0 && N[7] * MAX < total )
    {
      cout[7] = cout[17];
    }
    cout[17]++;
    cout[7]++;
    
    High_message8.id = 0x8;
    if(cout[7] > MAX )
    {
      High_message8.id = High_message8.id | 0x400;
      cout[7] = 0;
      cout[17] = 0;
    }
    if(High_message8.id == 0x8)
    {
      output(High_message8);
      tsend_count++;
    }
  }
  
  if(arr[8] == 0 && tsend_count < 4)
  {
    arr[8] = 1; 
    if(cout[8] == 0 && N[8] * MAX < total )
    {
      cout[8] = cout[18];
    }
    cout[18]++;
    cout[8]++;
    High_message9.id = 0x9;
    if(cout[8] > MAX )
    {
      High_message9.id = High_message9.id | 0x400;
      cout[8] = 0;
      cout[18] = 0;
    }
    if(High_message9.id == 0x9)
    {
      output(High_message9);
      tsend_count++;
    }
  }

  if(arr[9] == 0 && tsend_count < 4)
  {
    arr[9] = 1;
    if(cout[9] == 0 && N[9] * MAX < total )
    {
      cout[9] = cout[19];
    }
    cout[19]++;
    cout[9]++;
    High_message10.id = 0x10;
    if(cout[9] > MAX )
    {
      High_message10.id = High_message10.id | 0x400;
      cout[9] = 0;
      cout[19] = 0;
    }
    if(High_message10.id == 0x10)
    {
      output(High_message10);
      tsend_count++;
    }
  }
}
/*
函数功能：1.满足条件后实现由高到低以后的发送，只发送低优先级的情况，同时如果发送成功将发送条件破坏，使其只能在下一次周期循环再发
          2.如果不能发的话，若是处于低的期间则会将上次fsend_count累加的数值减1
*/
inversion_output()
{
  if(arr1[10] == 0 && tsend_count < 4)
  {
   output(Low_message1);
   tsend_count++;
   arr1[10] = 1;
  }
  
  if(arr1[11] == 0 && tsend_count < 4)
  {
    output(Low_message2);
    tsend_count++;
    arr1[11] = 1;
  }
  
  if(arr1[12] == 0 && tsend_count < 4)
  {
    output(Low_message3);
    tsend_count++;
    arr1[12] = 1;
  }
  
  if(arr1[13] == 0 && tsend_count < 4)
  {
    output(Low_message4);
    tsend_count++;
    arr1[13] = 1;
  }
  if(arr1[14] == 0 && tsend_count < 4)
  {
    output(Low_message5);
    tsend_count++;
    arr1[14] = 1;
  }
  
  //周期为20ms
  if(arr1[15] == 0 && tsend_count < 4)
  {
    arr1[15] = 1;
    tsend_count++;
    output(Low_message6);
  }
  
  if(arr1[16] == 0 && tsend_count < 4)
  {
    output(Low_message7);
    tsend_count++;
    arr1[16] = 1;
  }
  
  if(arr1[17] == 0 && tsend_count < 4)
  {
    output(Low_message8);
    tsend_count++;
    arr1[17] = 1;
  }
  if(arr1[18] == 0 && tsend_count < 4)
  {
    output(Low_message9);
    tsend_count++;
    arr1[18]=1;
  }
  
  if(arr1[19] == 0 && tsend_count < 4)
  {
    output(Low_message10);
    tsend_count++;
      
    arr1[19] = 1;
    jj = 1;
    MAX = 5;
  }
  //这里可以套出来很多公式，进行复杂化
  if(jj == 0 && per1[2] > 0 && tsend_count <= 4)
  {
    if((float)tsend_count/4 == 1.0)
    {
      //write("per1 = %f", (float)per1[2]);
      vv = (float)per1[2];
    }
    else
    {
      //write("per2 = %f", (float)per1[2] - (float)tsend_count/4);
      vv = (float)per1[2] - (float)tsend_count/4;
    }
    vv = vv/(float)N1[8];
    /*
    switch(vv*10)
    {
      case 2: MAX = 4; write("max = %d", MAX);break;
      case 4: MAX = 3; write("max = %d", MAX);break;
      case 6: MAX = 2; write("max = %d", MAX);break;
      case 8: MAX = 1; write("max = %d", MAX);break;
    }
         */
  }
  
  if(a[0] == MAX+1 && tsend_count < 4 && High_message1.id != 0x1)
  {
    k = 0;
    Data_cp1();
    //开始加密
    L[0] = High_message1.dword(0);
    R[0] = High_message1.dword(4);
    blowfish(); 
    //将加密的数据赋给报文；
    High_message1.dword(0) = L[0];
    High_message1.dword(4) = R[0];
    
    output(High_message1);
    cj[0] = 1;
    tsend_count++;
    a[0]++;
  }
  
  if(a[1] == MAX+1 && tsend_count < 4 && High_message2.id != 0x2)
  {
    k = 1;
    Data_cp2();      
    L[k] = High_message2.dword(0);
    R[k] = High_message2.dword(4);
    blowfish();
    High_message2.dword(0) = L[k];
    High_message2.dword(4) = R[k];
    
    output(High_message2); 
    cj[1] = 1;
     tsend_count++;
    a[1]++;
  }
  
  if(a[2] == MAX+1 && tsend_count < 4 && High_message3.id != 0x3)
  {
    High_message3.byte(0) = 0;
    High_message3.byte(1) = 0;
    output(High_message3); 
    High_message3.byte(0) = 0x1;
    High_message3.byte(1) = 0x22;
    tsend_count++;
    a[2]++;
  }
  
  if(a[3] == MAX+1 && tsend_count < 4 && High_message4.id != 0x4)
  {
    output(High_message4); 
    tsend_count++;
    a[3]++;
  }
  
  if(a[4] == MAX+1 && tsend_count < 4 && High_message5.id != 0x5)
  {
    output(High_message5); 
    tsend_count++;
    a[4]++;
  }
  
  if(a[5] == MAX+1 && tsend_count < 4 && High_message6.id != 0x6)
  {
    output(High_message6); 
    tsend_count++;
    a[5]++;
  }
  
  if(a[6] == MAX+1 && tsend_count < 4 && High_message7.id != 0x7)
  {
    output(High_message7); 
    tsend_count++;
    a[6]++;
  }
  
  if(a[7] == MAX+1 && tsend_count < 4 && High_message8.id != 0x8)
  {
    High_message8.byte(0) = 0x11;
    High_message8.byte(1) = 0x22;
    output(High_message8); 
    High_message8.byte(0) = 0x12;
    High_message8.byte(1) = 0;
    tsend_count++;
    a[7]++;
  }
  
  if(a[8] == MAX+1 && tsend_count < 4 && High_message9.id != 0x9)
  {
    High_message9.byte(0) = 0x11;
    output(High_message9); 
    High_message9.byte(0) = 0;
    tsend_count++;
    a[8]++;
  }
  
  if(a[9] == MAX+1 && tsend_count < 4 && High_message2.id != 0x10)
  {
    High_message10.byte(0) = 0x11;
    output(High_message10); 
    High_message10.byte(0) = 0x12;
    High_message10.byte(1) = 0;
    tsend_count++;
    a[9]++;
  }
}

/*
函数功能：将tsend_count发送的数量清零
*/
clear_mark()
{
  tsend_count = 0;
}





Data_cp1()
{
  //开始直接将发送报文清零
  Low_message11.qword(0) = High_message1.qword(0) = 0;
  //Rev_message1.qword(0) = 0;
  if(@sysvar::Engine::EngineStateSwitch) 
  {   
    //读取报文
    Low_message11.dword(0) = High_message1.dword(0) = @Engine::EngineSpeedEntry;
    Low_message11.byte(2) = High_message1.byte(2) = @Engine::EngineStateSwitch;
    
  }
  else
  {
    Low_message11.dword(0) = High_message1.dword(0) = 0;
    Low_message11.byte(2) = High_message1.byte(2) = 0;
    @Engine::kkk = 0;
  }
}

Data_cp2()
{
  int ii;
  Low_message12.qword(0) = High_message2.qword(0) = 0;

  if (@Lights::HazardLightsSwitch)
  {
    ii++;
  
    if(ii>0 && ii* N[1] <500)
      gHazardLightsStatus = 1;
    else
      gHazardLightsStatus = 0;
    if(ii* N[1]>1000)
      ii = 0;
  }
  else
    gHazardLightsStatus = 0;
  @Lights::fl = gHazardLightsStatus;
  if(@Lights::HeadLight1)
  {
    @Lights::HeadLight1 = 1;
  }
  else 
    @Lights::HeadLight1 = 0;
  
  Low_message12.byte(1) = High_message2.byte(1) = @Lights::HeadLight1;
  Low_message12.byte(0) = High_message2.byte(0) = @Lights::fl;
}









