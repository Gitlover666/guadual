/*@!Encoding:936*/
includes
{
  #include "bl.can"
}

/*
arr是触发标志位
cout是计数标志位
per是周期标志位
*/

variables
{

} 

low_task()
{
  if(per1[3] >= N1[4])
  {
    per1[3]=0;
    arr1[10]=0;  
    arr1[11]=0;  
  }
  
  if(per1[4] >= N1[5])
  {
    per1[4] = 0;
    arr1[12] = 0;
    arr1[13] = 0; 
  }
  
  if(per1[5] >= N1[6])
  {
    per1[5] = 0;
    arr1[14] = 0; 
    arr1[15] = 0;
  }
  
  if(per1[1] >= N1[7])
  {
    per1[1] = 0;
    arr1[16] = 0;
    arr1[17] = 0;
  }
  
  if(per1[2] >= N1[8])
  {
    per1[2] = 0;
    jj = 0;
    arr1[18] = 0; 
    arr1[19] = 0;   
  }
  
  per1[0]++;
  per1[1]++;  
  per1[2]++;
  per1[3]++;
  per1[4]++;
  per1[5]++;
}





















